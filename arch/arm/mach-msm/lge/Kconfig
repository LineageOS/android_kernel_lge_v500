## arch/arm/mach-msm/lge/Kconfig
```kconfig
config MACH_LGE
	bool

menu "LGE Board Selection"
source "arch/arm/mach-msm/lge/Kconfig.board"
endmenu


menu "LGE Specific Patches"

config LGE_QFPROM_INTERFACE
	bool "Support qfprom interface"
	default n
	depends on MACH_LGE
	help
	  LGE QFPROM DRIVER.

config LGE_QC_LCDC_LUT
	bool "Set initial Qualcomm LCDC lut"
	default n
	depends on MACH_LGE
	help
	  Set initial Qualcomm LCDC Look Up Table.

config LGE_KCAL
	bool "Interface to calibrate LCD color temperature"
	default n
	depends on MACH_LGE
	help
	  Interface to calibrate LCD color temperature

config LGE_KCAL_QLUT
	bool "Interface to calibrate LCD color temperature by QLUT"
	default n
	depends on MACH_LGE && LGE_QC_LCDC_LUT && LGE_KCAL
	help
	  Interface to calibrate LCD color temperature by QLUT

config EARJACK_DEBUGGER
	bool "Earjack UART debugger support"
	depends on MACH_APQ8064_GKU || MACH_APQ8064_GKKT || MACH_APQ8064_GKSK || MACH_APQ8064_GVKT || MACH_APQ8064_OMEGAR || MACH_APQ8064_OMEGA
	default n
	help
	  Saying Y here will support earjack type UART debugger cable

config LGE_BOOT_TIME_CHECK
	tristate "Support LGE BOOT TIME CHECK"
	default y
	depends on MACH_LGE
	help
	LGE SBL1 to LK BOOT TIME CHECKER.


#BEGIN: 0019632 chanha.park@lge.com 2012-05-31
#ADD: 0019632: [F200][BT] Bluetooth board bring-up
   config LGE_BLUESLEEP
       default n
       bool "APQ8064 LGE Bluetooth LPM"
       depends on MACH_LGE 
#END: 0019632 chanha.park@lge.com 2012-05-31 

config LGE_ECO_MODE
    tristate "Support LGE ECO Mode"
    default n
    depends on MACH_LGE
    help
      LGE ECO mode support

config LGE_CRASH_HANDLER
	tristate "Support LGE Crash Handler"
	depends on !S390 && !UML && HAVE_MEMBLOCK && MSM_DLOAD_MODE
	select ANDROID_PERSISTENT_RAM
	default n
	help
	  LGE Crash Handler


config LGE_BITE_RESET
        tristate "Disable PS_HOLD reset"
        default n
        depends on MACH_LGE
        help
          Reset device by WDT BITE instead of PS_HOLD

config LGE_R63311_COLOR_ENGINE
	bool "Interface to apply color engine"
	default y
	depends on MACH_LGE
	help
	  Interface to apply color engine

config LGIT_COLOR_ENGINE_SWITCH
	bool "Disable the color engine for camera"
	default y
	depends on MACH_LGE
	help
	  Enable the color engine on/off function for camera
config LGE_R63311_BACKLIGHT_CABC 
	bool "Interface to apply backlight cabc"
	default y
	depends on MACH_LGE
	help
	  Interface to apply backlight cabc

config LGE_BACKLIGHT_CABC
	bool "Interface to apply backlight cabc"
	default n
	depends on MACH_LGE
	help
	  Interface to apply backlight cabc
endmenu

config LGE_MSM_HSIC_TTY
    bool "LGE HSIC TTY Driver"
    default n
    help
      Provides a TTY driver HSIC TTY
      This driver can be used by user space
      applications for passing data through the
      HSIC interface.
```
